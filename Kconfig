## Kconfig
```kconfig
# ZMK module Kconfig for custom bootloader behavior

menu "ZMK Totem Dongle Module Options"

config ZMK_BEHAVIOR_BOOTLOADER_NRF
    bool "Enable nRF bootloader behavior"
    depends on ZMK
    default n
    help
      Enable the custom behavior `&bootloader_nrf` to enter bootloader.

choice BEHAVIOR_BOOTLOADER_NRF_MODE
    prompt "Bootloader trigger mode"
    depends on ZMK_BEHAVIOR_BOOTLOADER_NRF
    default BEHAVIOR_BOOTLOADER_NRF_MODE_UF2

config BEHAVIOR_BOOTLOADER_NRF_MODE_UF2
    bool "UF2 GPREGRET (0x57)"
    help
      Write GPREGRET=0x57 (Adafruit UF2) then warm reboot.

config BEHAVIOR_BOOTLOADER_NRF_MODE_MCUBOOT
    bool "MCUboot Serial Recovery (Boot Mode API)"
    help
      Set Zephyr boot mode to BOOT_MODE_TYPE_BOOTLOADER then warm reboot.
      Requires retention boot-mode DT and Kconfig (RETENTION, RETAINED_MEM,
      RETENTION_BOOT_MODE) and MCUboot serial (MCUBOOT_SERIAL, BOOT_SERIAL_BOOT_MODE).

endchoice

endmenu
```

## boards/shields/totem/Kconfig.defconfig
```kconfig
# Copyright (c) 2022 The ZMK Contributors
# SPDX-License-Identifier: MIT

if SHIELD_TOTEM_LEFT || SHIELD_TOTEM_RIGHT || SHIELD_TOTEM_DONGLE

config ZMK_SPLIT
    default y

config ZMK_BLE
    default y

config ZMK_BEHAVIOR_BOOTLOADER_NRF
    default y

config BEHAVIOR_BOOTLOADER_NRF_MODE_UF2
    default y

endif

# Dongle-specific config moved to totem_dongle.conf
```

## config/west.yml
```yaml
manifest:
  remotes:
    - name: zmkfirmware
      url-base: https://github.com/zmkfirmware
    - name: petejohanson
      url-base: https://github.com/petejohanson
    - name: ssbb
      url-base: https://github.com/ssbb
    - name: wlo2
      url-base: https://github.com/wlo2 
  projects:
    - name: zmk
      remote: petejohanson
      revision: core/move-to-zephyr-4-1
      import: app/west.yml
    - name: zmk-antecedent-morph
      remote: ssbb
      revision: v1
    - name: zmk_autocorrect
      remote: wlo2
      revision: main   
  self:
    path: config
```

## dts/bindings/behaviors/zmk,behavior-bootloader-nrf.yaml
```yaml
description: |
  nRF Bootloader behavior using Zephyr Boot Mode API for reliable bootloader entry

compatible: "zmk,behavior-bootloader-nrf"

include: base.yaml

properties:
  "#binding-cells":
    type: int
    const: 0
```
