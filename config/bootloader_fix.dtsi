/*
 * Copyright (c) 2024 The ZMK Contributors
 *
 * SPDX-License-Identifier: MIT
 */

/ {
    behaviors {
        bootloader_nrf: bootloader_nrf {
            compatible = "zmk,behavior-bootloader-nrf";
            #binding-cells = <0>;
        };
    };
};