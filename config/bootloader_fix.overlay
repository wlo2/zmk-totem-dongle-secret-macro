/*
 * Bootloader fix for Seeed XIAO nRF52840
 * 
 * Let's try the simplest approach - just force the bootloader behavior
 * to use a different reset type and see what happens.
 */

/ {
    behaviors {
        // Override the default bootloader behavior
        bootloader {
            compatible = "zmk,behavior-reset";
            #binding-cells = <0>;
            type = <1>; // Try cold reset instead of warm reset
        };
    };
};