#include "totem.dtsi"

/ {
    kscan0: kscan_0 {
        compatible = "zmk,kscan-mock";
        columns = <0>;
        rows = <0>;
        events = <0>;
    };
};

&default_layout {
    kscan = <&kscan0>;
};